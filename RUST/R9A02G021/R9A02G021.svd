# R9A02G021 register map
Vendor: Renesas Electronics Corporation; Series: RISC-V; File version: 1.10.00 + 202304131714_CPU
32-Bit MCU based on RISC-V
CPU: other r0p0, little endian, no MPU, no FPU, VTOR, 4 interrupt priority bits, 32 interrupts
Registers are 8-bit, read-write, reset 0x0 unless marked. A register's access mark holds for its fields unless they carry their own. Offsets are from the block's base; lines under a group give offsets from that group; [hi:lo] are bit positions; {n}, {i} and the like mark numbered series; 'fields as' and 'values as' point back to an identical list; <NAME> marks a mode.

## Memory map
0x40002000 SRAM blocks up to offset 0xD9 — SRAM Control
0x40003000 BUS blocks up to offset 0x1825 — BUS Control
0x40005400 DTC blocks up to offset 0x10 — Data Transfer Controller
0x40006000 ICU blocks up to offset 0x380 — ICU for CPU
0x4001A000 CPU_AUX blocks up to offset 0x204 — CPU Auxiliary Register
0x4001B000 CPU_DBG blocks up to offset 0x1000 — Debug Function
0x4001E000 SYSC blocks up to offset 0x493 — System Control
0x40040000 PORT0 size 0xC — Port 0 Control Registers
0x40040020 PORT1 size 0x10 — Port 1 Control Registers
0x40040040 PORT2 size 0x10 — Port 2 Control Registers
0x40040060 PORT3 size 0xC — Port 3 Control Registers
0x40040080 PORT4 size 0xC — Port 4 Control Registers
0x40040800 PFS blocks up to offset 0x510 — Pmn Pin Function Control Register
0x40041000 ELC blocks up to offset 0x6E — Event Link Controller
0x40044200 WDT blocks up to offset 0x9 — Watchdog Timer
0x40044400 IWDT blocks up to offset 0x6 — Independent Watchdog Timer
0x40044600 CAC blocks up to offset 0xC — Clock Frequency Accuracy Measurement Circuit
0x40047000 MSTP size 0xE — Module Stop Control B, C, D
0x4005E000 DAC8 blocks up to offset 0x702 — 8-bit D/A converter
0x40074000 CRC blocks up to offset 0xE — Cyclic Redundancy Check Calculator
0x40080000 KINT blocks up to offset 0x9 — Key Interrupt Function
0x40085F00 DOC blocks up to offset 0x18 — Data Operation Circuit
0x40091000 PORGA blocks up to offset 0x82 — Product Organize Register
0x40091100 TRNG blocks up to offset 0x4 — True Random Number Generator
0x40091200 CMP size 0x3 — Comparator
0x40092000 RTC size 0xD — Real Time Clock
0x40092100 REMC blocks up to offset 0x22 — Remote Control Signal Receiver
0x40092200 TML32 size 0xD — 32-bit Interval Timer
0x40093000 IICA size 0x284 — Serial Interface IICA
0x40094000 SAU0 blocks up to offset 0xBA — Serial Array Unit 0
0x40094100 SAU1 blocks up to offset 0xBA — Serial Array Unit 1
0x40095000 TAU blocks up to offset 0xC0 — Timer Array Unit
0x40096000 UARTA size 0x16
0x4009C000 ADC120 blocks up to offset 0xA8 — 12-bit A/D Converter
0x407EC000 FLCN blocks up to offset 0x3FC9 — Flash I/O Registers
0xE2000000 CLIC blocks up to offset 0x10CF — Core-Local Interrupt Controller
0xE6000000 MTIME blocks up to offset 0x1000 — Machine Timer
0xE6800000 DBG blocks up to offset 0xD0 — Debug Module

## Interrupts
{n} IEL{n} (ICU) (n=0..31) — ICU Interrupt {n}

## Licence text in the file
This software is supplied by Renesas Electronics Corporation and is only intended for use with Renesas products. No other uses are authorized. This software is owned by. Renesas Electronics Corporation and is protected under all applicable laws, including copyright laws. . THIS SOFTWARE IS PROVIDED "AS IS" AND RENESAS MAKES NO WARRANTIES REGARDING. THIS SOFTWARE, WHETHER EXPRESS, IMPLIED OR STATUTORY, INCLUDING BUT NOT LIMITED TO. WARRANTIES OF MERCHANTABILITY, FITNESS FOR A PARTICULAR PURPOSE AND NON-INFRINGEMENT. ALL SUCH WARRANTIES ARE EXPRESSLY DISCLAIMED. TO THE MAXIMUM EXTENT PERMITTED NOT. PROHIBITED BY LAW, NEITHER RENESAS ELECTRONICS CORPORATION NOR ANY OF ITS AFFILIATED. COMPANIES SHALL BE LIABLE FOR ANY DIRECT, INDIRECT, SPECIAL, INCIDENTAL OR CONSEQUENTIAL. DAMAGES FOR ANY REASON RELATED TO THIS SOFTWARE, EVEN IF RENESAS OR ITS AFFILIATES HAVE. BEEN ADVISED OF THE POSSIBILITY OF SUCH DAMAGES. . Renesas reserves the right, without notice, to make changes to this software and to discontinue the availability of this software. By using this software, you agree to the additional terms and conditions found by accessing the following link: http://www.renesas.com/disclaimer
